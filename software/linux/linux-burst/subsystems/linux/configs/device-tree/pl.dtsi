/*
 * CAUTION: This file is automatically generated by Xilinx.
 * Version: HSI 
 * Today is: Tue Feb  2 18:24:20 2016
*/


/ {
	amba_pl: amba_pl {
		#address-cells = <1>;
		#size-cells = <1>;
		compatible = "simple-bus";
		ranges ;
		dut_interface_burst_config_0: dut_interface_burst_config@43c00000 {
			compatible = "xlnx,dut-interface-burst-config-1.0";
			reg = <0x43c00000 0x10000 0x7aa00000 0x10000>;
			xlnx,s00-axi-addr-width = <0xa>;
			xlnx,s00-axi-aruser-width = <0x0>;
			xlnx,s00-axi-awuser-width = <0x0>;
			xlnx,s00-axi-buser-width = <0x0>;
			xlnx,s00-axi-data-width = <0x20>;
			xlnx,s00-axi-id-width = <0xc>;
			xlnx,s00-axi-ruser-width = <0x0>;
			xlnx,s00-axi-wuser-width = <0x0>;
			xlnx,s01-axi-addr-width = <0x5>;
			xlnx,s01-axi-data-width = <0x20>;
		};
	};
};
